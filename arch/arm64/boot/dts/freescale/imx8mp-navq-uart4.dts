// SPDX-License-Identifier: (GPL-2.0+ OR MIT)
/*
 * Copyright 2023 Emcraft Systems
 */

#include "imx8mp-navq.dts"

&uart4 {
	pinctrl-names = "default";
	pinctrl-0 = <&pinctrl_uart4>;
	assigned-clocks = <&clk IMX8MP_CLK_UART4>;
	assigned-clock-parents = <&clk IMX8MP_SYS_PLL1_80M>;
	fsl,uart-has-rtscts;
	status = "okay";
};

&iomuxc {
	pinctrl_uart4: uart4grp {
		fsl,pins = <
			MX8MP_IOMUXC_ECSPI2_SCLK__UART4_DCE_RX      0x140
			MX8MP_IOMUXC_ECSPI2_MOSI__UART4_DCE_TX      0x140
			MX8MP_IOMUXC_ECSPI2_SS0__UART4_DCE_RTS      0x140
			MX8MP_IOMUXC_ECSPI2_MISO__UART4_DCE_CTS     0x140
		>;
	};
};
